## firmware/MaixPy/components/micropython/Kconfig
```kconfig
config COMPONENT_MICROPYTHON_ENABLE
	bool "Enbale micropython component"
	default n
	select COMPONENT_KENDRYTE_SDK_ENABLE
	select COMPONENT_DRIVERS_ENABLE
	select COMPONENT_SPIFFS_ENABLE
	select COMPONENT_UTILS_ENABLE

menu "Micropython configurations"
	depends on COMPONENT_MICROPYTHON_ENABLE
	config MAIXPY_GC_HEAP_SIZE
		hex "GC heap size, hex format, MUST be aligned 8 Bytes, default 512kB(0x80000)"
		default 0xD0000
	menu "Modules configurations"

		config MAIXPY_IDE_SUPPORT
			bool "Enable MaixPy IDE protocol support"
			default y

		config MAIXPY_THREAD_ENABLE
			bool "Enable _thread module"
			default y
			select FREERTOS_ENABLE
			select STATIC_TASK_CLEAN_UP_ENABLE

		config MAIXPY_TOUCH_SCREEN_ENABLE
			bool "Enable touch screen module"
			default y

		choice MAIXPY_TOUCH_SCREEN_DRIVER
			bool "Select touch screen driver"
			default MAIXPY_TOUCH_SCREEN_DRIVER_NS2009
			depends on MAIXPY_TOUCH_SCREEN_ENABLE
			config MAIXPY_TOUCH_SCREEN_DRIVER_NS2009
				bool "Select ns2009 touch screen driver"
			config MAIXPY_TOUCH_SCREEN_DRIVER_FT52XX
				bool "Select ft52xx touch screen driver"
		endchoice

		config MAIXPY_OMV_MINIMUM
			bool "Minimum size OMV function (just disable omv advanced functions )"
			default n
		config MAIXPY_OMV_CONV_YUV_FAST
			bool "Add YUV convert table, speed up convert but more code"
			default n
		config MAIXPY_OMV_DOUBLE_BUFF
			bool "Set double buffer for sensor(camera)"
			default y

		config MICROPYTHON_SECP256K1_ENABLE
			bool "Enable secp256k1-embedded module"
			default y

		config MICROPYTHON_HASHLIB_ENABLE
			bool "Enable hashlib module"
			default y

		config MICROPYTHON_QRCODE_ENABLE
			bool "Enable qrcode module"
			default y
	endmenu

	menu "Builtin py modules configurations"

		config MAIXPY_BUILTIN_PY_PYE
			bool "Enable builtin py module pye (about 17KiB)"
			default y
		config MAIXPY_BUILTIN_PY_BOARD
			bool "Enable builtin py module board"
			default y
		config MAIXPY_BUILTIN_PY_FPIOA_MANAGER
			bool "Enable builtin py module fpioa_manager"
			default y
	endmenu

	menu "Debug configurations"
		config MAIXPY_K210_UARTHS_DEBUG
			bool "Use UARTHS to debug(pin9, pin10), UART2 to REPL(pin4, pin5)"
			default n
	endmenu

	config BUILTIN_PY_DIR
		string "builtin py directory"
		default ""
endmenu
```
